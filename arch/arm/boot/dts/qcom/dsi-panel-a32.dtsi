/* Copyright (c) 2013, The Linux Foundation. All rights reserved.
 *
 * This program is free software; you can redistribute it and/or modify
 * it under the terms of the GNU General Public License version 2 and
 * only version 2 as published by the Free Software Foundation.
 *
 * This program is distributed in the hope that it will be useful,
 * but WITHOUT ANY WARRANTY; without even the implied warranty of
 * MERCHANTABILITY or FITNESS FOR A PARTICULAR PURPOSE.  See the
 * GNU General Public License for more details.
 */

/*---------------------------------------------------------------------------
 * This file is autogenerated file using gcdb parser. Please do not edit it.
 * Update input XML file to add a new entry or update variable in this file
 * VERSION = "1.0"
 *---------------------------------------------------------------------------*/
&mdss_mdp {
	qcom,mdss_dsi_a32_tianma_hx8394d_video {
		compatible = "qcom,mdss_dsi_tianma_hx8394d_video";
		status = "disable";
		qcom,cont-splash-enabled;
		qcom,mdss-dsi-panel-name = "a32 720p tianma_hx8394d video mode dsi panel";
		qcom,mdss-dsi-panel-controller = <&mdss_dsi0>;
		qcom,mdss-dsi-panel-type = "dsi_video_mode";
		qcom,mdss-dsi-panel-destination = "display_1";
		qcom,mdss-dsi-panel-framerate = <60>;
		qcom,mdss-dsi-virtual-channel-id = <0>;
		qcom,mdss-dsi-stream = <0>;
		qcom,mdss-dsi-panel-width = <720>;
		qcom,mdss-dsi-panel-height = <1280>;
		qcom,mdss-dsi-h-front-porch = <100>;
		qcom,mdss-dsi-h-back-porch = <100>;
		qcom,mdss-dsi-h-pulse-width = <36>;
		qcom,mdss-dsi-h-sync-skew = <0>;
		qcom,mdss-dsi-v-back-porch = <12>;
		qcom,mdss-dsi-v-front-porch = <15>;
		qcom,mdss-dsi-v-pulse-width = <4>;
		qcom,mdss-dsi-h-left-border = <0>;
		qcom,mdss-dsi-h-right-border = <0>;
		qcom,mdss-dsi-v-top-border = <0>;
		qcom,mdss-dsi-v-bottom-border = <0>;
		qcom,mdss-dsi-bpp = <24>;
		qcom,mdss-dsi-color-order = "rgb_swap_rgb";
		qcom,mdss-dsi-underflow-color = <0xff>;
		qcom,mdss-dsi-border-color = <0>;
		qcom,mdss-dsi-on-command = [
			39 01 00 00 00 00 04 B9 FF 83 94
			39 01 00 00 00 00 03 BA 72 83
			39 01 00 00 00 00 10 B1 6C 0F 0F 35 04 11 F1 80 DE D4 23 80 C0 D2 18
			39 01 00 00 00 00 0C B2 00 64 0E 0D 32 23 08 08 1C 4D 00
			15 01 00 00 01 00 02 BC 07
			39 01 00 00 00 00 0D B4 00 FF 03 5A 03 5A 03 5A 01 6A 01 6A
			39 01 00 00 00 00 26 D3 00 07 00 00 00 10 00 32 10 05 00 05 32 10 00 00 00 32 10 00 00 00 36 03 09 09 37 00 00 37 00 00 00 00 0A 00 01
			39 01 00 00 00 00 2D D5 02 03 00 01 06 07 04 05 20 21 22 23 18 18 18 18 18 18 18 18 18 18 18 18 18 18 18 18 18 18 18 18 18 18 18 18 18 18 24 25 18 18 19 19
			39 01 00 00 00 00 2D D6 05 04 07 06 01 00 03 02 23 22 21 20 18 18 18 18 18 18 18 18 18 18 18 18 18 18 18 18 18 18 18 18 18 18 18 18 18 18 25 24 19 19 18 18
			39 01 00 00 00 00 2B E0 02 0E 16 29 28 3F 27 45 06 0A 0C 17 10 14 16 14 15 08 12 16 19 02 0E 16 29 28 3F 27 45 06 0A 0C 17 10 14 16 14 15 08 12 16 19
			39 01 00 00 00 00 02 BD 00
			39 01 00 00 00 00 2C C1 01 00 08 0E 14 1D 25 2E 36 3F 47 4F 58 60 68 70 79 81 89 91 9A A1 A8 B1 B8 C0 C9 D0 D8 E0 E8 EF F7 FF 03 B2 98 98 29 72 0F 0A C0
			39 01 00 00 00 00 02 BD 01
			39 01 00 00 00 00 2B C1 00 08 0D 14 1D 26 2E 37 40 48 50 59 61 69 71 7A 82 8A 93 9B A2 AA B2 B9 C2 CB D2 DA E1 E9 F0 F7 FE 0F 88 08 AD 73 DF 0D 4A 00
			39 01 00 00 00 00 02 BD 02
			39 01 00 00 00 00 2B C1 00 08 0B 14 1D 26 2F 37 40 48 51 5A 62 6B 72 7B 83 8C 94 9D A4 AB B4 BB C3 CC D4 DA E1 E8 EF F5 FA 08 03 E6 CF F6 B4 22 20 00
			15 01 00 00 00 00 02 CC 09
			39 01 00 00 00 00 03 C0 30 14
			39 01 00 00 00 00 05 C7 00 C0 40 C0
			15 01 00 00 00 00 02 51 00
			39 01 00 00 00 00 08 C9 1F 00 14 1E 81 1E 00
			15 01 00 00 05 00 02 55 11
			15 01 00 00 00 00 02 5E 00
			39 01 00 00 00 00 0A CA 2D 26 25 23 22 22 21 20 20
			39 01 00 00 00 00 23 CE 00 00 00 00 00 00 00 00 00 00 00 00 00 00 00 00 00 00 00 00 00 00 00 00 00 00 00 00 00 00 00 00 00 00
			39 01 00 00 0A 00 03 E4 05 00
			39 01 00 00 0A 00 0C E5 00 00 05 08 0C 07 02 02 02 02 02
			39 01 00 00 05 00 12 E6 00 00 00 00 00 00 13 17 20 20 20 20 1F 20 16 20 20
			05 01 00 00 78 00 02 11 00
		];
		qcom,mdss-dsi-off-command = [
			05 01 00 00 01 00 02 28 00 /* display_off */
			05 01 00 00 78 00 02 10 00 /* Sleep in */];
		qcom,mdss-dsi-on-command-state = "dsi_lp_mode";
		qcom,mdss-dsi-off-command-state = "dsi_hs_mode";
		qcom,mdss-dsi-h-sync-pulse = <0>;
		qcom,mdss-dsi-traffic-mode = "non_burst_sync_event";
		qcom,mdss-dsi-bllp-eof-power-mode;
		qcom,mdss-dsi-lane-map = "lane_map_0123";
		qcom,mdss-dsi-bllp-power-mode;
		qcom,mdss-dsi-lane-0-state;
		qcom,mdss-dsi-lane-1-state;
		qcom,mdss-dsi-lane-2-state;
		qcom,mdss-dsi-panel-timings = [38 2F 25 00 70 82 2A 31 3C 03 04 00];
		qcom,mdss-dsi-t-clk-post = <0x1f>;
		qcom,mdss-dsi-t-clk-pre = <0x39>;
		qcom,mdss-dsi-bl-min-level = <1>;
		qcom,mdss-dsi-bl-max-level = <255>;
		qcom,mdss-dsi-dma-trigger = "trigger_sw";
		qcom,mdss-dsi-mdp-trigger = "none";
		qcom,mdss-dsi-bl-pmic-control-type = "bl_ctrl_dcs";
		qcom,display-on-cmds = [05 01 00 00 0A 00 02 29 00 /* LCD Display on */
		                        15 01 00 00 00 00 02 53 24];
		qcom,mdss-dsi-default-command-state = "dsi_hs_mode";

		htc,cabc-off-cmds   = [15 01 00 00 05 00 02 55 00];
		htc,cabc-ui-cmds    = [
							15 01 00 00 05 00 02 55 11
							15 01 00 00 05 00 02 5E 00
							39 01 00 00 00 00 0A CA 2D 26 25 23 22 22 21 20 20
							39 01 00 00 00 00 23 CE 00 00 00 00 00 00 00 00 00
							00 00 00 00 00 00 00 00 00 00
							00 00 00 00 00 00 00 00 00 00
							00 00 00 00 00
								];
		htc,cabc-video-cmds = [
							15 01 00 00 05 00 02 55 11
							15 01 00 00 00 00 02 5E 00
							39 01 00 00 00 00 0A CA 40 2E 2A 24 23 22 21 20 20
							39 01 00 00 00 00 23 CE 00 00 00 00 00 00 00 00 00 00 00 00 00 00 00 00 00 00 00 00 00 00 00 00 00 00 00 00 00 00 00 00 00 00
								];
		htc,dimming-on-cmds = [15 01 00 00 00 00 02 53 2C];

		qcom,mdss-pan-physical-width-dimension = <62>;
		qcom,mdss-pan-physical-height-dimension = <110>;
		qcom,mdss-shrink-pwm = <6 86 255>;
		qcom,mdss-dsi-lp11-init;
		htc,mdss-camera-blk = <187>;
		htc,panel-id = <4>;
	};

	qcom,mdss_dsi_a32_truly_hx8394d_video {
		compatible = "qcom,mdss_dsi_truly_hx8394d_video";
		status = "disable";
		qcom,cont-splash-enabled;
		qcom,mdss-dsi-panel-name = "a32 720p truly_hx8394d video mode dsi panel";
		qcom,mdss-dsi-panel-controller = <&mdss_dsi0>;
		qcom,mdss-dsi-panel-type = "dsi_video_mode";
		qcom,mdss-dsi-panel-destination = "display_1";
		qcom,mdss-dsi-panel-framerate = <60>;
		qcom,mdss-dsi-virtual-channel-id = <0>;
		qcom,mdss-dsi-stream = <0>;
		qcom,mdss-dsi-panel-width = <720>;
		qcom,mdss-dsi-panel-height = <1280>;
		qcom,mdss-dsi-h-front-porch = <100>;
		qcom,mdss-dsi-h-back-porch = <70>;
		qcom,mdss-dsi-h-pulse-width = <30>;
		qcom,mdss-dsi-h-sync-skew = <0>;
		qcom,mdss-dsi-v-back-porch = <16>;
		qcom,mdss-dsi-v-front-porch = <6>;
		qcom,mdss-dsi-v-pulse-width = <2>;
		qcom,mdss-dsi-h-left-border = <0>;
		qcom,mdss-dsi-h-right-border = <0>;
		qcom,mdss-dsi-v-top-border = <0>;
		qcom,mdss-dsi-v-bottom-border = <0>;
		qcom,mdss-dsi-bpp = <24>;
		qcom,mdss-dsi-color-order = "rgb_swap_rgb";
		qcom,mdss-dsi-underflow-color = <0xff>;
		qcom,mdss-dsi-border-color = <0>;
		qcom,mdss-dsi-on-command = [
			39 01 00 00 00 00 04 B9 FF 83 94
			39 01 00 00 00 00 03 BA 72 83
			39 01 00 00 00 00 10 B1 6C 55 15 11 04 11 F1 80 E8 95 23 80 C0 D2 58
			39 01 00 00 00 00 0C B2 00 64 10 07 32 1C 08 08 1C 4D 00
			15 01 00 00 00 00 02 BC 07
			39 01 00 00 00 00 0D B4 00 FF 03 5C 03 5C 03 5C 01 6C 01 6C
			39 01 00 00 00 00 02 D2 55
			39 01 00 00 00 00 1F D3 00 06 00 01 1A 08 00 32 10 07 00 07 54 15 0F 05 04 02 12 10 05 07 33 33 0B 0B 37 10 07 07
			39 01 00 00 00 00 2D D5 19 19 18 18 1B 1B 1A 1A 04 05 06 07 00 01 02 03 20 21 18 18 22 23 18 18 18 18 18 18 18 18 18 18 18 18 18 18 18 18 18 18 18 18 18 18
			39 01 00 00 00 00 2D D6 18 18 19 19 1B 1B 1A 1A 03 02 01 00 07 06 05 04 23 22 18 18 21 20 18 18 18 18 18 18 18 18 18 18 18 18 18 18 18 18 18 18 18 18 18 18
			39 01 00 00 00 00 2B E0 00 08 0D 2E 35 3F 1A 3A 07 0A 0C 17 0E 11 13 11 13 07 12 13 17 00 08 0D 2E 35 3F 1A 3A 07 0A 0C 17 0E 11 13 11 13 07 12 13 17
			39 01 00 00 00 00 02 BD 00
			39 01 00 00 00 00 2C C1 01 00 08 0F 17 1F 27 2F 37 3E 46 4E 56 5B 61 6B 73 7A 84 8A 91 99 9F A7 B0 B6 BE C5 CD D4 DD E2 EA F3 0E AA E8 E9 D6 87 90 48 40
			39 01 00 00 00 00 02 BD 01
			39 01 00 00 00 00 2B C1 00 08 0F 17 1F 27 2F 37 40 47 4E 56 5D 64 6B 73 7B 82 8A 92 9A A2 AA B1 B9 C0 C8 CF D7 DD E5 ED F5 0E A5 2C 6E 7F F7 6B 7D 00
			39 01 00 00 00 00 02 BD 02
			39 01 00 00 00 00 2B C1 00 08 11 1A 22 2B 33 3C 44 4C 54 5B 63 6A 72 7B 83 8B 93 9B A4 AB B3 BC C3 CB D3 DB E3 EA F2 FA FF 24 88 F7 3C 26 2C 94 00 C0

			39 01 00 00 00 00 03 C0 30 14
			39 01 00 00 00 00 05 C7 00 C0 00 C0
			39 01 00 00 00 00 02 CC 09
			39 01 00 00 00 00 02 DF 87

			15 01 00 00 05 00 02 C6 BD
			15 01 00 00 05 00 02 BD 02
			39 01 00 00 05 00 0D D8 FF FF EF BE AA A0 FF FF EF BE AA A0
			15 01 00 00 05 00 02 BD 00

			39 01 00 00 00 00 08 C9 1F 00 14 1E 81 1E 00
			15 01 00 00 05 00 02 55 11
			15 01 00 00 00 00 02 5E 00
			39 01 00 00 00 00 0A CA 40 30 2F 2E 2D 26 23 21 20
			39 01 00 00 00 00 23 CE 00 00 00 10 10 10 10 20 20 20 20 20 20 20 30 30 30 30 30 30 30 30 30 30 30 30 30 30 30 30 30 30 30 30
			//15 01 00 00 00 00 02 53 24
			39 01 00 00 0A 00 03 E4 01 00
			39 01 00 00 0A 00 20 E5 00 00 06 04 06 00 00 10 80 00 00 01 01 01 01 02 F6 08 00 05 05 05 05 05 04 04 05 06 05 03 02
			39 01 00 00 05 00 14 E6 80 08 00 05 05 3F 10 7F 20 7F 20 10 10 10 20 20 20 00 00
			05 01 00 00 78 00 02 11 00
			];
		qcom,mdss-dsi-off-command = [
			05 01 00 00 01 00 02 28 00 /* display_off */
			05 01 00 00 78 00 02 10 00 /* Sleep in */];
		qcom,mdss-dsi-on-command-state = "dsi_lp_mode";
		qcom,mdss-dsi-off-command-state = "dsi_hs_mode";
		qcom,mdss-dsi-h-sync-pulse = <0>;
		qcom,mdss-dsi-traffic-mode = "non_burst_sync_event";
		qcom,mdss-dsi-bllp-eof-power-mode;
		qcom,mdss-dsi-lane-map = "lane_map_0123";
		qcom,mdss-dsi-bllp-power-mode;
		qcom,mdss-dsi-lane-0-state;
		qcom,mdss-dsi-lane-1-state;
		qcom,mdss-dsi-lane-2-state;
		qcom,mdss-dsi-panel-timings = [A3 24 18 00 4C 50 1C 28 1D 03 04 00];
		qcom,mdss-dsi-t-clk-post = <0x04>;
		qcom,mdss-dsi-t-clk-pre = <0x20>;
		qcom,mdss-dsi-bl-min-level = <1>;
		qcom,mdss-dsi-bl-max-level = <255>;
		qcom,mdss-dsi-dma-trigger = "trigger_sw";
		qcom,mdss-dsi-mdp-trigger = "none";
		qcom,mdss-dsi-bl-pmic-control-type = "bl_ctrl_dcs";
		qcom,display-on-cmds = [05 01 00 00 0A 00 02 29 00 /* LCD Display on */
		                        15 01 00 00 00 00 02 53 24];
		qcom,mdss-dsi-default-command-state = "dsi_hs_mode";

		htc,cabc-off-cmds   = [15 01 00 00 05 00 02 55 00];
		htc,cabc-ui-cmds    = [
							15 01 00 00 05 00 02 55 11
							15 01 00 00 05 00 02 5E 00
							39 01 00 00 00 00 0A CA 2D 26 25 23 22 22 21 20 20
							39 01 00 00 00 00 23 CE 00 00 00 00 00 00 00 00 00
							00 00 00 00 00 00 00 00 00 00
							00 00 00 00 00 00 00 00 00 00
							00 00 00 00 00
								];
		htc,cabc-video-cmds = [
							15 01 00 00 05 00 02 55 11
							15 01 00 00 00 00 02 5E 00
							39 01 00 00 00 00 0A CA 40 2E 2A 24 23 22 21 20 20
							39 01 00 00 00 00 23 CE 00 00 00 00 00 00 00 00 00 00 00 00 00 00 00 00 00 00 00 00 00 00 00 00 00 00 00 00 00 00 00 00 00 00
								];
		htc,dimming-on-cmds = [15 01 00 00 00 00 02 53 2C];

		qcom,mdss-pan-physical-width-dimension = <62>;
		qcom,mdss-pan-physical-height-dimension = <110>;
		qcom,mdss-shrink-pwm = <6 86 255>;
		qcom,mdss-dsi-lp11-init;
		htc,mdss-camera-blk = <187>;
		htc,panel-id = <5>;
	};
};
