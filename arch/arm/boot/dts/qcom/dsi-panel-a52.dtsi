&mdss_mdp {
	qcom,mdss_dsi_a52_tianma_renesas_63315_1080p_video {
		compatible = "qcom,mdss-dsi-panel";
		status = "disable";
		qcom,cont-splash-enabled;
		qcom,mdss-dsi-panel-name = "A52 1080p_Tianma /Renesas 63315 video mode dsi panel";
		qcom,mdss-dsi-panel-controller = <&mdss_dsi0>;
		qcom,mdss-dsi-panel-type = "dsi_video_mode";
		qcom,mdss-dsi-panel-destination = "display_1";
		qcom,mdss-dsi-panel-framerate = <60>;
		qcom,mdss-dsi-virtual-channel-id = <0>;
		qcom,mdss-dsi-stream = <0>;
		qcom,mdss-dsi-panel-width = <1080>;
		qcom,mdss-dsi-panel-height = <1920>;
		qcom,mdss-dsi-h-front-porch = <72>;
		qcom,mdss-dsi-h-back-porch = <44>;
		qcom,mdss-dsi-h-pulse-width = <20>;
		qcom,mdss-dsi-h-sync-skew = <0>;
		qcom,mdss-dsi-v-back-porch = <4>;
		qcom,mdss-dsi-v-front-porch = <14>;
		qcom,mdss-dsi-v-pulse-width = <2>;
		qcom,mdss-dsi-h-left-border = <0>;
		qcom,mdss-dsi-h-right-border = <0>;
		qcom,mdss-dsi-v-top-border = <0>;
		qcom,mdss-dsi-v-bottom-border = <0>;
		qcom,mdss-dsi-bpp = <24>;
		qcom,mdss-dsi-color-order = "rgb_swap_rgb";
		qcom,mdss-dsi-underflow-color = <0xff>;
		qcom,mdss-dsi-border-color = <0>;
		htc-fmt,mdss-dsi-on-command =
			"DTYPE_GEN_LWRITE", <0>, <2>, [B0 04],/* Manufacturer_Command */
			"DTYPE_GEN_LWRITE", <0>, <2>, [3A 70],/* set_pixel_format */
			"DTYPE_GEN_LWRITE", <0>, <2>, [D6 01],/* sequencer_test_control */
			"DTYPE_GEN_LWRITE", <0>, <7>, [B3 14 00 00 00 00 00],/* display_mode_video  */
			"DTYPE_GEN_LWRITE", <0>, <3>, [B4 0C 00],/* set_fourlane  */
			"DTYPE_GEN_LWRITE", <0>, <3>, [B6 3A D3],/* dsi_control */
			"DTYPE_GEN_LWRITE", <0>, <2>, [B7 00],/* checksum_ecc_error_count */
			"DTYPE_GEN_LWRITE", <0>, <7>, [B8 07 B0 25 18 03 65],/* backlight_control_1 */
			"DTYPE_GEN_LWRITE", <0>, <7>, [B9 07 53 62 20 08 66],/* backlight_control_2 */
			"DTYPE_GEN_LWRITE", <0>, <7>, [BA 07 78 64 10 64 B4],/* backlight_control_3 */
			"DTYPE_GEN_LWRITE", <0>, <3>, [BE 00 04],/* external_clock_setting */
			"DTYPE_GEN_LWRITE", <0>, <2>, [C0 11],/* sout */
			"DTYPE_GEN_LWRITE", <0>, <35>, [C1 84 60 00 FF 8F F2 D1 31 E1 47 F8 5C 63 AC B9
					07 E3 07 E6 FC 4F C4 FF 00 00 00 00 00 68 01 00 22 00 01],/* display_setting */
			"DTYPE_GEN_LWRITE", <0>, <8>, [C2 31 F7 82 06 06 00 00],/* inversion */
			"DTYPE_GEN_LWRITE", <0>, <4>, [C3 00 00 00],/* tpc_sync_control_vsout_hsout_off */
			"DTYPE_GEN_LWRITE", <0>, <23>, [C4 70 01 00 01 01 01 01 01 01 01 03 00 00 00 00
					00 00 00 00 00 01 03],/* source_timing_setting */
			"DTYPE_GEN_LWRITE", <0>, <2>, [C5 00],/* real_timing_scaling_off */
			"DTYPE_GEN_LWRITE", <0>, <41>, [C6 71 00 00 08 66 00 00 00 00 00 00 00 00 00 00
					00 00 14 16 07 71 00 00 08 66 00 00 00 00 00 00 00 00 00 00 00 00 14 16 07],/* st_sw */
			"DTYPE_GEN_LWRITE", <0>, <33>, [CA 00 00 00 00 00 00 00 00 08 00 00 00 0A 00 00 00
					01 00 00 08 00 00 08 08 00 00 10 10 30 30 30 30],/* still mode */
			"DTYPE_GEN_LWRITE", <0>, <10>, [CB EC FD BF 37 20 00 00 04 C0],/* panel_pin_control */
			"DTYPE_GEN_LWRITE", <0>, <2>, [CC 0E],/* panel_interface_control_b */
			"DTYPE_GEN_LWRITE", <0>, <24>, [CE F5 43 47 4A 51 59 61 72 84 98 B2 C4 D5 E7 F7 FC FF 01 5F 04 04 00 20],/* */
			"DTYPE_GEN_LWRITE", <0>, <6>, [CF 00 00 C1 05 3F],/* gpo_control_off */
			"DTYPE_GEN_LWRITE", <20>, <11>, [D0 11 85 BB 54 CF 4C 19 19 0C 00],/* charge_pump_power_setting_1 */
			"DTYPE_GEN_LWRITE", <20>, <27>, [D1 20 00 00 04 08 0C 10 00 00 00 00 00 3C 04 20 00 00 04
					08 0C 10 00 00 3C C6 F0],/* charge_pump_power_setting_2 */
			"DTYPE_GEN_LWRITE", <20>, <26>, [D3 1B 33 BB BB B3 33 33 33 00 01 00 A0 C8 A0 0D 42
					42 33 3B 37 72 57 3D BF 33],/* internal_power_setting 1*/
			"DTYPE_GEN_LWRITE", <0>, <23>, [D7 84 E0 7F A8 CE 38 FC C1 18 E7 8F 1F 3C 10 FA C3 0F 04
					41 00 00 00],/* Power_on_timing_control */
			"DTYPE_GEN_LWRITE", <0>, <3>, [DD 10 8C],/* outline_sharpening_control */
			"DTYPE_DCS_WRITE1", <0>, <2>, [53 24],/* ctrl_display */
			"DTYPE_DCS_LWRITE", <0>, <2>, [55 02],/* content adaptive_brightness_control */
			"DTYPE_DCS_WRITE", <150>, <2>, [11 00];/* exit sleep */
		htc-fmt,mdss-dsi-off-command =
			"DTYPE_DCS_WRITE" , <10>, <2>, [28 00],/* display_off */
			"DTYPE_GEN_LWRITE", <0>, <2>, [B0 04],/* Manufacturer_Command */
			"DTYPE_GEN_LWRITE", <0>, <2>, [D6 01],/* sequencer_test_control */
			"DTYPE_GEN_LWRITE", <50>, <26>, [D3 13 33 BB B3 B3 33 33 33 00 01 00 A0 E8 A0 0D 42 42 33
					3B 37 72 57 3D BF 33],/* internal_power_setting 2*/
			"DTYPE_DCS_WRITE" , <120>, <2>, [10 00];/* Sleep in */
		htc-fmt,display-on-cmds =
			"DTYPE_DCS_WRITE" , <0>, <2>, [29 00];/* LCD Display on */
		qcom,mdss-dsi-on-command-state = "dsi_lp_mode";
		qcom,mdss-dsi-off-command-state = "dsi_hs_mode";
		qcom,mdss-dsi-h-sync-pulse = <0>;
		qcom,mdss-dsi-traffic-mode = "non_burst_sync_event";
		qcom,mdss-dsi-bllp-eof-power-mode;
		qcom,mdss-dsi-lane-map = "lane_map_0123";
		qcom,mdss-dsi-bllp-power-mode;
		qcom,mdss-dsi-lane-0-state;
		qcom,mdss-dsi-lane-1-state;
		qcom,mdss-dsi-lane-2-state;
		qcom,mdss-dsi-lane-3-state;
		qcom,mdss-dsi-panel-timings = [DA 34 24 00 64 68 28 40 2A 03 04 00];
		qcom,mdss-dsi-t-clk-post = <0x03>;
		qcom,mdss-dsi-t-clk-pre = <0x29>;
		qcom,mdss-dsi-bl-min-level = <1>;
		qcom,mdss-dsi-bl-max-level = <255>;
		qcom,mdss-dsi-dma-trigger = "trigger_sw";
		qcom,mdss-dsi-mdp-trigger = "none";
		qcom,mdss-dsi-bl-pmic-control-type = "bl_ctrl_dcs";
		htc-fmt,dimming-on-cmds = "DTYPE_DCS_LWRITE", <0>, <2>, [53 2C];
		qcom,mdss-dsi-default-command-state = "dsi_hs_mode";
		qcom,mdss-pan-physical-width-dimension = <68>;
		qcom,mdss-pan-physical-height-dimension = <121>;
		qcom,mdss-shrink-pwm = <6 76 255>;
		qcom,mdss-dsi-lp11-init;
		htc,mdss-camera-blk = <191>;
		htc,panel-id=<1>;
		qcom,dlnx_fifo_overflow;
	};
	qcom,mdss_dsi_a52_truly_renesas_63315_1080p_video {
		compatible = "qcom,mdss-dsi-panel";
		status = "disable";
		qcom,cont-splash-enabled;
		qcom,mdss-dsi-panel-name = "A52 1080p_Truly /Renesas 63315 video mode dsi panel";
		qcom,mdss-dsi-panel-controller = <&mdss_dsi0>;
		qcom,mdss-dsi-panel-type = "dsi_video_mode";
		qcom,mdss-dsi-panel-destination = "display_1";
		qcom,mdss-dsi-panel-framerate = <60>;
		qcom,mdss-dsi-virtual-channel-id = <0>;
		qcom,mdss-dsi-stream = <0>;
		qcom,mdss-dsi-panel-width = <1080>;
		qcom,mdss-dsi-panel-height = <1920>;
		qcom,mdss-dsi-h-front-porch = <100>;
		qcom,mdss-dsi-h-back-porch = <60>;
		qcom,mdss-dsi-h-pulse-width = <20>;
		qcom,mdss-dsi-h-sync-skew = <0>;
		qcom,mdss-dsi-v-back-porch = <6>;
		qcom,mdss-dsi-v-front-porch = <10>;
		qcom,mdss-dsi-v-pulse-width = <2>;
		qcom,mdss-dsi-h-left-border = <0>;
		qcom,mdss-dsi-h-right-border = <0>;
		qcom,mdss-dsi-v-top-border = <0>;
		qcom,mdss-dsi-v-bottom-border = <0>;
		qcom,mdss-dsi-bpp = <24>;
		qcom,mdss-dsi-color-order = "rgb_swap_rgb";
		qcom,mdss-dsi-underflow-color = <0xff>;
		qcom,mdss-dsi-border-color = <0>;
		htc-fmt,mdss-dsi-on-command =
			"DTYPE_GEN_LWRITE", <0>, <2>, [B0 04],/* Manufacturer_Command */
			"DTYPE_GEN_LWRITE", <0>, <2>, [D6 01],/* sequencer_test_control */
			"DTYPE_GEN_LWRITE", <0>, <7>, [B3 14 00 00 00 00 00],/* display_mode_video  */
			"DTYPE_GEN_LWRITE", <0>, <3>, [B6 3A D3],/* dsi_control */
			"DTYPE_GEN_LWRITE", <0>, <35>, [C1 84 60 00 20 A9 30 FE 62 FF FF FF 9B 7B CF B5
					FF FF FF 6C 7D 22 54 02 00 00 00 00 00 62 03 00 22 00 01],/* display_setting */
			"DTYPE_GEN_LWRITE", <0>, <8>, [C2 32 F7 80 08 08 00 00],/* inversion */
			"DTYPE_GEN_LWRITE", <0>, <23>, [C4 70 0C 0C 55 55 00 00 00 00 05 05 00 0C 0C 55
					55 00 00 00 00 05 05],/* source_timing_setting */
			"DTYPE_GEN_LWRITE", <0>, <41>, [C6 75 32 32 00 00 00 00 00 00 00 00 00 00 00 00
					00 00 09 19 09 75 32 32 00 00 00 00 00 00 00 00 00 00 00 00 00 00 09 19 09],/* ltps_setting */
			"DTYPE_GEN_LWRITE", <0>, <31>, [C7 00 08 0F 18 27 36 42 53 38 40 4C 59 63 6B 75
					00 08 0F 18 27 36 42 53 38 40 4C 59 63 6B 75],/* analog_gamma_setting */
			"DTYPE_GEN_LWRITE", <0>, <20>, [C8 01 00 FF FE F8 FC 00 00 00 01 FD DB 00 00 FF 03
					05 F6 00],/* digital_gamma_function */
			"DTYPE_GEN_LWRITE", <0>, <10>, [CB FF FF FF FF 00 00 00 00 C0],/* panel_pin_control */
			"DTYPE_GEN_LWRITE", <0>, <2>, [CC 11],/* panel_interface_control_b */
			"DTYPE_GEN_LWRITE", <0>, <11>, [D0 C4 81 BB 58 58 4C 19 19 04 00],/* charge_pump_power_setting */
			"DTYPE_GEN_LWRITE", <0>, <26>, [D3 1B 33 BB BB B3 33 33 33 00 01 00 A0 D8 A0 00 44
					44 33 3B 22 72 57 3D BF 99],/* internal_power_setting 1*/
			"DTYPE_DCS_WRITE1", <0>, <2>, [53 24],/* ctrl_display */
			"DTYPE_DCS_LWRITE", <0>, <2>, [55 02],/* content adaptive_brightness_control */
			"DTYPE_DCS_WRITE", <120>, <2>, [11 00];/* exit sleep */
		htc-fmt,mdss-dsi-off-command =
			"DTYPE_DCS_WRITE" , <10>, <2>, [28 00],/* display_off */
			"DTYPE_GEN_LWRITE", <0>, <2>, [B0 04],/* Manufacturer_Command */
			"DTYPE_GEN_LWRITE", <0>, <2>, [D6 01],/* sequencer_test_control */
			"DTYPE_GEN_LWRITE", <50>, <26>, [D3 13 33 BB B3 B3 33 33 33 00 01 00 A0 D8 A0 00 44 44 33
					3B 22 72 57 3D BF 99],/* internal_power_setting 2*/
			"DTYPE_DCS_WRITE" , <120>, <2>, [10 00];/* Sleep in */
		htc-fmt,display-on-cmds =
			"DTYPE_DCS_WRITE" , <0>, <2>, [29 00];/* LCD Display on */
		qcom,mdss-dsi-on-command-state = "dsi_lp_mode";
		qcom,mdss-dsi-off-command-state = "dsi_hs_mode";
		qcom,mdss-dsi-h-sync-pulse = <0>;
		qcom,mdss-dsi-traffic-mode = "non_burst_sync_event";
		qcom,mdss-dsi-bllp-eof-power-mode;
		qcom,mdss-dsi-lane-map = "lane_map_0123";
		qcom,mdss-dsi-bllp-power-mode;
		qcom,mdss-dsi-lane-0-state;
		qcom,mdss-dsi-lane-1-state;
		qcom,mdss-dsi-lane-2-state;
		qcom,mdss-dsi-lane-3-state;
		qcom,mdss-dsi-panel-timings = [E7 36 24 00 66 6A 2A 42 2D 03 04 00];
		qcom,mdss-dsi-t-clk-post = <0x03>;
		qcom,mdss-dsi-t-clk-pre = <0x2B>;
		qcom,mdss-dsi-bl-min-level = <1>;
		qcom,mdss-dsi-bl-max-level = <255>;
		qcom,mdss-dsi-dma-trigger = "trigger_sw";
		qcom,mdss-dsi-mdp-trigger = "none";
		qcom,mdss-dsi-bl-pmic-control-type = "bl_ctrl_dcs";
		htc-fmt,dimming-on-cmds = "DTYPE_DCS_LWRITE", <0>, <2>, [53 2C];
		qcom,mdss-dsi-default-command-state = "dsi_hs_mode";
		qcom,mdss-pan-physical-width-dimension = <68>;
		qcom,mdss-pan-physical-height-dimension = <121>;
		qcom,mdss-shrink-pwm = <6 76 255>;
		qcom,mdss-dsi-lp11-init;
		htc,mdss-camera-blk = <191>;
		htc,panel-id=<2>;
		qcom,dlnx_fifo_overflow;
	};
};
